## bmcrpi_build/conf/bblayers.conf
```bitbake
# LAYER_CONF_VERSION is increased each time build/conf/bblayers.conf
# changes incompatibly
LCONF_VERSION = "8"

BBPATH = "${TOPDIR}"
BBFILES ?= ""

BBLAYERS ?= " \
  /home/user/RPI4_BMC/openbmc/meta \
  /home/user/RPI4_BMC/openbmc/poky/meta-poky \
  /home/user/RPI4_BMC/openbmc/meta-openembedded/meta-oe \
  /home/user/RPI4_BMC/openbmc/meta-openembedded/meta-networking \
  /home/user/RPI4_BMC/openbmc/meta-openembedded/meta-python \
  /home/user/RPI4_BMC/openbmc/meta-phosphor \
  /home/user/RPI4_BMC/openbmc/meta-raspberrypi \
  /home/user/RPI4_BMC/bmcrpi_build/workspace \
  "
```
